## sdkconfig.defaults
```kconfig
# =============================================================================
# HARDWARE-INDEPENDENT CONFIGURATION (Common for all targets)
# =============================================================================

# -----------------------------------------------------------------------------
# WiFi Configuration (same network regardless of hardware)
# -----------------------------------------------------------------------------
CONFIG_AG_WIFI_SSID="WIFI_SID"
CONFIG_AG_WIFI_PASSWORD="WIFI_PASSWORD"

# -----------------------------------------------------------------------------
# Application Features (hardware-independent)
# -----------------------------------------------------------------------------
# WebRTC Configuration
CONFIG_WEBRTC_PROVIDER_OPENAI=y
CONFIG_AG_WEBRTC_SUPPORT_OPUS=y
CONFIG_AG_WEBRTC_DATA_CHANNEL_ENABLED=y

# Vision Configuration
CONFIG_AG_VISION_PREVIEW_PORT=8080

# Camera Configuration
CONFIG_AG_VISION_DEFAULT_FPS=15
CONFIG_AG_VISION_DEFAULT_QUALITY=1
CONFIG_AG_VISION_JPEG_QUALITY=10
CONFIG_AG_VISION_BUFFER_FRAMES=3

# Recording Configuration
CONFIG_AG_VISION_CAPTURE_INTERVAL_MS=500

# Audio Configuration
CONFIG_AG_AUDIO_DEFAULT_PLAYBACK_VOL=75
CONFIG_AG_AUDIO_DEFAULT_MIC_GAIN=95

# -----------------------------------------------------------------------------
# Network Protocols (common for all hardware)
# -----------------------------------------------------------------------------
# Support 2 SNTP servers
CONFIG_LWIP_SNTP_MAX_SERVERS=2

# Enable DTLS SRTP for WebRTC
CONFIG_MBEDTLS_SSL_PROTO_DTLS=y
CONFIG_MBEDTLS_SSL_DTLS_SRTP=y
CONFIG_MBEDTLS_X509_CREATE_C=y

# -----------------------------------------------------------------------------
# Debug & Development Features (common)
# -----------------------------------------------------------------------------
# Enable GDBStub for debugging
CONFIG_ESP_SYSTEM_PANIC_GDBSTUB=y

# FreeRTOS trace facility moved to Memory Optimization section

# Task watchdog for stability
CONFIG_ESP_TASK_WDT_EN=y
CONFIG_ESP_TASK_WDT_TIMEOUT_S=15

# Increase stack watermark checking to ensure stability
CONFIG_FREERTOS_CHECK_STACKOVERFLOW_CANARY=y
CONFIG_FREERTOS_WATCHPOINT_END_OF_STACK=y

# Enable experimental features
CONFIG_IDF_EXPERIMENTAL_FEATURES=y

# -----------------------------------------------------------------------------
# Common Memory & Task Configuration
# -----------------------------------------------------------------------------
# Scheduler optimizations - reduced for memory
CONFIG_FREERTOS_IDLE_TASK_STACKSIZE=1536
CONFIG_FREERTOS_TIMER_TASK_STACK_DEPTH=2048
CONFIG_ESP_MAIN_TASK_STACK_SIZE=4096
CONFIG_ESP_SYSTEM_EVENT_TASK_STACK_SIZE=2560

# -----------------------------------------------------------------------------
# Build Optimizations (common)
# -----------------------------------------------------------------------------
CONFIG_COMPILER_OPTIMIZATION_SIZE=y

# Use custom partition table
CONFIG_PARTITION_TABLE_CUSTOM=y
CONFIG_PARTITION_TABLE_CUSTOM_FILENAME="partitions.csv"

# -----------------------------------------------------------------------------
# OpenAI Vision API Configuration
# -----------------------------------------------------------------------------
CONFIG_AG_VISION_REALTIME_FRAMES_COUNT=2

# -----------------------------------------------------------------------------
# OpenAI Realtime API Configuration
# -----------------------------------------------------------------------------
CONFIG_AG_OPENAI_REALTIME_MODEL="gpt-realtime"
CONFIG_AG_OPENAI_TOOL_CHOICE="auto"
CONFIG_AG_OPENAI_VOICE="ash"

# -----------------------------------------------------------------------------
# Memory Optimization Settings
# -----------------------------------------------------------------------------
# Reduce WiFi buffers
CONFIG_ESP32_WIFI_STATIC_RX_BUFFER_NUM=4
CONFIG_ESP32_WIFI_DYNAMIC_RX_BUFFER_NUM=8
CONFIG_ESP32_WIFI_STATIC_TX_BUFFER_NUM=4
CONFIG_ESP32_WIFI_TX_BUFFER_TYPE=0
CONFIG_ESP32_WIFI_RX_BA_WIN=4
CONFIG_ESP32_WIFI_AMPDU_TX_ENABLED=n
CONFIG_ESP32_WIFI_AMPDU_RX_ENABLED=y

# Reduce LWIP buffers
CONFIG_LWIP_TCP_SND_BUF_DEFAULT=4096
CONFIG_LWIP_TCP_WND_DEFAULT=4096
CONFIG_LWIP_TCP_RECVMBOX_SIZE=6
CONFIG_LWIP_UDP_RECVMBOX_SIZE=6
CONFIG_LWIP_TCPIP_RECVMBOX_SIZE=16

# HTTP client optimizations
CONFIG_ESP_HTTP_CLIENT_ENABLE_HTTPS=y
CONFIG_MBEDTLS_DYNAMIC_BUFFER=y
CONFIG_MBEDTLS_DYNAMIC_FREE_CONFIG_DATA=y
CONFIG_MBEDTLS_DYNAMIC_FREE_CA_CERT=y

# Disable unnecessary features
CONFIG_ESP32_DEBUG_OCDAWARE=n
# Keep trace facility enabled - required by memory_manager.c
CONFIG_FREERTOS_USE_TRACE_FACILITY=y
CONFIG_FREERTOS_VTASKLIST_INCLUDE_COREID=y
CONFIG_FREERTOS_GENERATE_RUN_TIME_STATS=y
```

## sdkconfig.defaults.esp32s3
```kconfig
# =============================================================================
# ESP32-S3 COMMON CONFIGURATION
# =============================================================================
# This file contains settings common to ALL ESP32-S3 boards
# Board-specific differences (flash size, PSRAM mode) go in sdkconfig.defaults.[board]
# =============================================================================

# -----------------------------------------------------------------------------
# ESP32-S3 CPU & Performance (Common for all boards)
# -----------------------------------------------------------------------------
CONFIG_ESP_DEFAULT_CPU_FREQ_MHZ_240=y
CONFIG_ESP32S3_INSTRUCTION_CACHE_32KB=y
CONFIG_ESP32S3_DATA_CACHE_64KB=y
CONFIG_ESP32S3_DATA_CACHE_LINE_64B=y

# -----------------------------------------------------------------------------
# ESP32-S3 SPIRAM Base Configuration (Common settings)
# -----------------------------------------------------------------------------
CONFIG_ESP32S3_SPIRAM_SUPPORT=y
CONFIG_SPIRAM=y

# PSRAM memory allocation strategies (common for all boards)
CONFIG_SPIRAM_ALLOW_BSS_SEG_EXTERNAL_MEMORY=y
CONFIG_SPIRAM_ALLOW_NOINIT_SEG_EXTERNAL_MEMORY=y
CONFIG_SPIRAM_TRY_ALLOCATE_WIFI_LWIP=y
CONFIG_SPIRAM_MALLOC_ALWAYSINTERNAL=256
CONFIG_MBEDTLS_EXTERNAL_MEM_ALLOC=y

# -----------------------------------------------------------------------------
# Audio Hardware Configuration (Common for ESP32-S3)
# -----------------------------------------------------------------------------
# I2S Digital Microphone Configuration
CONFIG_USE_I2S_MICROPHONE=y
CONFIG_AG_AUDIO_MIC_SAMPLE_RATE=24000
CONFIG_AG_AUDIO_MIC_BIT_DEPTH=16
CONFIG_AG_AUDIO_MIC_CHANNELS=1
CONFIG_AG_AUDIO_MIC_EXTENDED_BIT_DEPTH=24
CONFIG_AG_AUDIO_ENABLE_AEC=n

# -----------------------------------------------------------------------------
# Flash Configuration (Freenove specific)
# -----------------------------------------------------------------------------
CONFIG_ESPTOOLPY_FLASHFREQ_120M=y
CONFIG_ESPTOOLPY_FLASHSIZE_8MB=y

# I2C codec configuration
CONFIG_CODEC_I2C_BACKWARD_COMPATIBLE=n
```

## sdkconfig.defaults.esp32s3.freenove
```kconfig
# =============================================================================
# FREENOVE_ESP32_S3_WROOM SPECIFIC CONFIGURATION
# =============================================================================
# This file contains ONLY the settings specific to the Freenove board
# Common ESP32-S3 settings are in sdkconfig.defaults.esp32s3
# =============================================================================

# -----------------------------------------------------------------------------
# Board Identification
# -----------------------------------------------------------------------------
CONFIG_AG_SYSTEM_BOARD_NAME="FREENOVE_ESP32_S3_WROOM"

# -----------------------------------------------------------------------------
# Flash Configuration (Freenove specific)
# -----------------------------------------------------------------------------
CONFIG_ESPTOOLPY_FLASHFREQ_120M=y
CONFIG_ESPTOOLPY_FLASHSIZE_8MB=y

# -----------------------------------------------------------------------------
# SPIRAM Configuration (Freenove: Octal SPI)
# -----------------------------------------------------------------------------
CONFIG_SPIRAM_MODE_OCT=y
CONFIG_SPIRAM_SPEED_120M=y
```

## sdkconfig.defaults.esp32s3.n16r8cam
```kconfig
# =============================================================================
# ESP32_S3_N16R8_CAM SPECIFIC CONFIGURATION
# =============================================================================
# This file contains ONLY the settings specific to the N16R8 CAM board
# Common ESP32-S3 settings are in sdkconfig.defaults.esp32s3
# =============================================================================

# -----------------------------------------------------------------------------
# Board Identification
# -----------------------------------------------------------------------------
CONFIG_AG_SYSTEM_BOARD_NAME="ESP32_S3_N16R8_CAM"

# -----------------------------------------------------------------------------
# Flash Configuration (N16R8 CAM specific)
# -----------------------------------------------------------------------------
CONFIG_ESPTOOLPY_FLASHFREQ_80M=y
CONFIG_ESPTOOLPY_FLASHSIZE_16MB=y
CONFIG_ESPTOOLPY_FLASHSIZE="16MB"

# -----------------------------------------------------------------------------
# SPIRAM Configuration (N16R8 CAM: Quad SPI)
# -----------------------------------------------------------------------------
CONFIG_SPIRAM_MODE_QUAD=y
CONFIG_SPIRAM_SPEED_80M=y
CONFIG_SPIRAM_SPEED=80
```
