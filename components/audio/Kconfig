## components/audio/Kconfig
```kconfig
menu "OpenAI WebRTC - Audio"

    config USE_I2S_MICROPHONE
        bool "Use I2S Digital Microphone"
        default y
        help
            Enable support for I2S digital microphones (e.g., INMP441, ICS-43434, SPH0645, etc.)
            These are digital MEMS microphones with I2S interface

    config AG_AUDIO_MIC_SAMPLE_RATE
        int "Microphone Sample Rate"
        default 24000
        help
            Sample rate in Hz for microphone capture

    config AG_AUDIO_MIC_BIT_DEPTH
        int "Microphone Bit Depth"
        default 16
        help
            Bit depth for audio samples

    config AG_AUDIO_MIC_CHANNELS
        int "Microphone Channels"
        default 1
        help
            Number of audio channels (1 for mono, 2 for stereo)

    config AG_AUDIO_MIC_EXTENDED_BIT_DEPTH
        int "Extended Bit Depth"
        default 24
        depends on USE_I2S_MICROPHONE
        help
            Native bit capability for I2S microphones (many support 24-bit)

    config AG_AUDIO_DEFAULT_PLAYBACK_VOL
        int "Default Playback Volume"
        range 0 100
        default 80
        help
            Default playback volume level (0-100)

    config AG_AUDIO_DEFAULT_MIC_GAIN
        int "Default Microphone Gain"
        range 0 100
        default 80
        help
            Default microphone gain level (0-100)

    config AG_AUDIO_ENABLE_AEC
        bool "Enable Acoustic Echo Cancellation"
        default n
        help
            Enable AEC processing for better audio quality
            Note: AEC may cause stability issues on some configurations

endmenu
```

## components/system/Kconfig
```kconfig
menu "OpenAI WebRTC - System"

    config AG_SYSTEM_TASK_STACK_SIZE
        int "Default Task Stack Size"
        default 4096
        help
            Default stack size for system tasks

    config AG_SYSTEM_TASK_PRIORITY
        int "Default Task Priority"
        default 5
        help
            Default priority for system tasks

    config AG_SYSTEM_BOARD_NAME
        string "Board Name"
        default "FREENOVE_ESP32_S3_WROOM"
        help
            Board identification string

    menu "Console Configuration"
        
        config AG_CONSOLE_ENABLE
            bool "Enable Console Commands"
            default y
            help
                Enable interactive console commands

        config AG_CONSOLE_MAX_CMDLINE_LENGTH
            int "Maximum Command Line Length"
            default 256
            depends on AG_CONSOLE_ENABLE
            help
                Maximum length of console command line

        config AG_CONSOLE_MAX_CMDLINE_ARGS
            int "Maximum Command Arguments"
            default 16
            depends on AG_CONSOLE_ENABLE
            help
                Maximum number of arguments in a console command
            
    endmenu

endmenu
```

## components/vision/Kconfig
```kconfig
menu "OpenAI WebRTC  - Vision"

    config AG_VISION_ENABLE
        bool "Enable Vision Module"
        default y
        help
            Enable camera and vision processing capabilities

    menu "Camera Configuration"
        depends on AG_VISION_ENABLE
        
        config AG_VISION_DEFAULT_FPS
            int "Default Camera FPS"
            range 1 30
            default 15
            help
                Default frames per second for camera capture
        
        config AG_VISION_DEFAULT_QUALITY
            int "Default Camera Quality (0=LOW, 1=MEDIUM, 2=HIGH, 3=HD)"
            range 0 3
            default 1
            help
                Default camera quality setting
        
        config AG_VISION_JPEG_QUALITY
            int "JPEG Compression Quality"
            range 1 100
            default 10
            help
                JPEG quality (lower value = better quality on ESP32)
        
        config AG_VISION_BUFFER_FRAMES
            int "Frame Buffer Size"
            range 1 10
            default 3
            help
                Number of frames to buffer in queue
    endmenu

    menu "Voice Detection Configuration"
        depends on AG_VISION_ENABLE
        
        config AG_VOICE_ENERGY_THRESHOLD
            int "Voice Energy Threshold"
            range 100 1000
            default 300
            help
                Energy threshold for voice detection (lower = more sensitive)
        
        config AG_VOICE_MIN_DURATION_MS
            int "Minimum Voice Duration (ms)"
            range 50 500
            default 150
            help
                Minimum duration to consider as valid voice activity
        
        config AG_VOICE_SILENCE_TIMEOUT_MS
            int "Voice Silence Timeout (ms)"
            range 1000 10000
            default 3000
            help
                Duration of silence before considering voice stopped
        
    endmenu

    menu "Recording Configuration"
        depends on AG_VISION_ENABLE
        
        config AG_VISION_CAPTURE_INTERVAL_MS
            int "Default Capture Interval (ms)"
            range 50 5000
            default 500
            help
                Default interval for continuous capture mode
        
        config AG_VISION_RECORDING_DEFAULT_FPS
            int "Default Recording FPS"
            range 1 30
            default 10
            help
                Default FPS for video recording mode
    endmenu

    config AG_VISION_PREVIEW_PORT
        int "Camera Preview Server Port"
        default 8080
        depends on AG_VISION_ENABLE
        help
            HTTP port for camera preview server

endmenu
```

## components/webrtc/Kconfig
```kconfig
menu "OpenAI WebRTC  - WebRTC"

    choice WEBRTC_PROVIDER
        prompt "WebRTC Provider"
        default WEBRTC_PROVIDER_OPENAI
        help
            Select the WebRTC signaling provider

        config WEBRTC_PROVIDER_OPENAI
            bool "OpenAI Realtime API"
            help
                Use OpenAI's realtime API for WebRTC signaling

        config WEBRTC_PROVIDER_WHIP
            bool "WHIP Protocol"
            help
                Use WHIP (WebRTC-HTTP ingestion protocol)
    endchoice

    config AG_WEBRTC_SUPPORT_OPUS
        bool "Support OPUS Codec"
        default y
        help
            Enable OPUS audio codec support

    config AG_WEBRTC_DATA_CHANNEL_ENABLED
        bool "Enable Data Channel"
        default y
        help
            Enable WebRTC data channel support
            
    config AG_VISION_ANALYSIS_TASK_STACK_SIZE
        int "Vision analysis task stack size"
        default 16384
        help
            Stack size in bytes for the vision analysis task that processes OpenAI vision API responses.
            Increase this value if you experience stack overflow errors.

    config AG_VISION_ANALYSIS_TASK_PRIORITY
        int "Vision analysis task priority"
        default 5
        range 1 10
        help
            Priority of the vision analysis task. Higher values give the task higher priority.
            
    menu "OpenAI API Configuration"
        depends on WEBRTC_PROVIDER_OPENAI
        
        config AG_OPENAI_REALTIME_MODEL
            string "OpenAI Realtime Model"
            default "gpt-4o-mini-realtime-preview"
            help
                OpenAI model to use for realtime API

        config AG_OPENAI_TOOL_CHOICE
            string "Tool Choice"
            default "auto"
            help
                Tool choice parameter for OpenAI API
                
        config AG_OPENAI_VOICE
            string "Default Voice"
            default "ash"
            help
                Default voice for OpenAI TTS
                
        config AG_OPENAI_TYPE_SESSION_UPDATE
            string "Session Update Type"
            default "session.update"
            help
                Type identifier for session update messages
                
        config AG_OPENAI_TYPE_CONVERSATION_ITEM_CREATE
            string "Conversation Item Create Type"
            default "conversation.item.create"
            help
                Type identifier for conversation item create messages
                
        config AG_OPENAI_TYPE_RESPONSE_CREATE
            string "Response Create Type"
            default "response.create"
            help
                Type identifier for response create messages
                
        config AG_OPENAI_TYPE_MESSAGE
            string "Message Type"
            default "message"
            help
                Type identifier for message items
                
        config AG_OPENAI_TYPE_FUNCTION_CALL_OUTPUT
            string "Function Call Output Type"
            default "function_call_output"
            help
                Type identifier for function call output
                
        config AG_OPENAI_TYPE_INPUT_TEXT
            string "Input Text Type"
            default "input_text"
            help
                Type identifier for input text content
                
        config AG_OPENAI_FIELD_TYPE
            string "Type Field Name"
            default "type"
            help
                JSON field name for type
                
        config AG_OPENAI_FIELD_ROLE
            string "Role Field Name"
            default "role"
            help
                JSON field name for role
                
        config AG_OPENAI_FIELD_MODEL
            string "Model Field Name"
            default "model"
            help
                JSON field name for model
                
        config AG_OPENAI_FIELD_VOICE
            string "Voice Field Name"
            default "voice"
            help
                JSON field name for voice
    endmenu

    menu "OpenAI Vision API Configuration"
        depends on AG_VISION_ENABLE

        config AG_VISION_REALTIME_FRAMES_COUNT
            int "Number of frames to send via Realtime API"
            default 2
            range 1 5
            help
                Number of frames to send simultaneously to OpenAI Realtime API for better context.
                More frames provide better temporal context but increase data usage.

        config AG_VISION_OPENAI_FAST_MAX_TOKENS
            int "Max tokens for fast vision analysis (quick response)"
            default 50
            range 30 100
            help
                Maximum number of tokens for ultra-fast vision response

        config AG_VISION_OPENAI_DETAILED_MAX_TOKENS
            int "Max tokens for detailed vision analysis (context gathering)"
            default 300
            range 200 800
            help
                Maximum number of tokens for detailed vision context

        config AG_VISION_OPENAI_TEMPERATURE
            string "Temperature for OpenAI API"
            default "0.6"
            help
                Temperature parameter for OpenAI API (0.0 to 1.0)

        config AG_VISION_OPENAI_ROLE_USER
            string "User role name"
            default "user"
            help
                Role name for user messages

        config AG_VISION_OPENAI_ROLE_ASSISTANT
            string "Assistant role name"
            default "assistant"
            help
                Role name for assistant messages

        config AG_VISION_OPENAI_ROLE_SYSTEM
            string "System role name"
            default "system"
            help
                Role name for system messages

        config AG_VISION_OPENAI_TYPE_TEXT
            string "Text content type"
            default "text"
            help
                Type identifier for text content

        config AG_VISION_OPENAI_TYPE_IMAGE_URL
            string "Image URL content type"
            default "image_url"
            help
                Type identifier for image URL content

        config AG_VISION_OPENAI_FIELD_TYPE
            string "Type field name"
            default "type"
            help
                JSON field name for type

        config AG_VISION_OPENAI_FIELD_ROLE
            string "Role field name"
            default "role"
            help
                JSON field name for role

        config AG_VISION_OPENAI_FIELD_CONTENT
            string "Content field name"
            default "content"
            help
                JSON field name for content

        config AG_VISION_OPENAI_FIELD_URL
            string "URL field name"
            default "url"
            help
                JSON field name for URL

    endmenu

    menu "Debug Options"
        config AG_WEBRTC_DEBUG_LOGS
            bool "Enable WebRTC debug logs"
            default n
            help
                Enable detailed logging for WebRTC operations.
                
        config AG_TRANSCRIPT_LOGGING
            bool "Enable transcript logging"
            default n
            help
                Enable logging of audio transcripts to console.
    endmenu

endmenu
```

## components/wifi/Kconfig
```kconfig
menu "OpenAI WebRTC - Network/WiFi"

    config AG_WIFI_SSID
        string "WiFi SSID"
        default "YourWiFiNetwork"
        help
            WiFi network name to connect to

    config AG_WIFI_PASSWORD
        string "WiFi Password"
        default "YourWiFiPassword"
        help
            WiFi network password

endmenu
```
